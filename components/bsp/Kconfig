## components/bsp/Kconfig
```kconfig
menu "BSP"

choice BSP_BOARD_TARGET
    prompt "Target board"
    default BSP_BOARD_DOERS3

config BSP_BOARD_DOERS3
    bool "DoerS3"

config BSP_BOARD_AURAS3
    bool "AuraS3"

endchoice

config BSP_ENABLE_CAMERA
    bool "Enable BSP camera support"
    depends on BSP_BOARD_DOERS3
    default n
    help
        Build the DoerS3 camera port and link esp32-camera dependencies.
        Keep this disabled for apps that do not use camera to reduce build and
        link dependencies.

endmenu
```

## components/bsp/test_app/board/sdkconfig.defaults
```kconfig
CONFIG_IDF_TARGET="esp32s3"
CONFIG_BSP_BOARD_DOERS3=y
CONFIG_ESPTOOLPY_FLASHSIZE_16MB=y
CONFIG_PARTITION_TABLE_SINGLE_APP_LARGE=y
CONFIG_ESP_DEFAULT_CPU_FREQ_MHZ_240=y
```

## components/bsp/test_app/camera/sdkconfig.defaults
```kconfig
CONFIG_IDF_TARGET="esp32s3"
CONFIG_BSP_BOARD_DOERS3=y
CONFIG_ESPTOOLPY_FLASHSIZE_16MB=y
CONFIG_PARTITION_TABLE_SINGLE_APP_LARGE=y
CONFIG_SPIRAM=y
CONFIG_SPIRAM_MODE_OCT=y
CONFIG_SPIRAM_XIP_FROM_PSRAM=y
CONFIG_SPIRAM_SPEED_80M=y
CONFIG_ESP_DEFAULT_CPU_FREQ_MHZ_240=y
CONFIG_ESP_MAIN_TASK_STACK_SIZE=8192
```

## components/bsp/test_app/pmu/sdkconfig.defaults
```kconfig
CONFIG_IDF_TARGET="esp32s3"
CONFIG_COMPILER_OPTIMIZATION_DEBUG=y
CONFIG_LOG_DEFAULT_LEVEL_INFO=y
CONFIG_ESP_TASK_WDT=n
```
